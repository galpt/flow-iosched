## block/Kconfig.iosched
```kconfig
config MQ_IOSCHED_FLOW
	tristate "Multi-Lane I/O scheduler (FLOW)"
	default m
	help
	  The Multi-Lane I/O scheduler (FLOW) v4.0 is a blk-mq I/O
	  scheduler with three priority tiers (Emergency > Read > Write),
	  per-hw-context FIFO dispatch, and a generalised N-lane
	  starvation-bound framework (starvation_max_read / starvation_max_write)
	  that is provably starvation-free by construction.

	  Architecture highlights:
	    - Per-hw-context state with independent locking (kyber-like scaling)
	    - Zero per-request dynamic allocations (mq-deadline discipline)
	    - Completion-triggered re-dispatch (BFQ pipeline-refill pattern)
	    - Starvation-bounded dispatch via bypass_count/starvation_max counters
	    - No autotune timer, no per-process scheduling state

config MQ_IOSCHED_DEFAULT_FLOW
	bool "Enable FLOW I/O scheduler as the default MQ scheduler"
	depends on MQ_IOSCHED_FLOW
	help
	  Make flow-iosched the default MQ I/O scheduler.  Note: this
	  requires wiring into elevator_set_default() in block/elevator.c,
	  which is kernel-version-specific and is NOT handled by this
	  patch.  For most users, the standalone module build (via the
	  install-flow-iosched.sh script) is the recommended approach.
```
